#define KERNEL_OFFSET 0xffffffff80000000

ENTRY(start)

SECTIONS
{
	. = KERNEL_OFFSET + 0x100000;
    _kernel_start = .;

    .text : AT(ADDR(.text) - KERNEL_OFFSET)
	{
		*(.multiboot_header)
		*(.text)
	}

    /* Read-only data. */
    .rodata : AT(ADDR(.rodata) - KERNEL_OFFSET)
    {
        *(.gdt64)
        *(.rodata)
    }

    /* Read-write data (initialized) */
    .data : AT(ADDR(.data) - KERNEL_OFFSET)
    {
        *(.data)
    }

    /* Read-write data (uninitialized) and stack */
    .bss : AT(ADDR(.bss) - KERNEL_OFFSET)
    {
        *(.bss)
    }

    _kernel_end = .;
}
